## zmk-a320-driver/Kconfig
```kconfig
# A320 Trackpad Controller

# Copyright (C) 2022 Ryan Walker <info@interruptlabs.ca>
# SPDX-License-Identifier: Apache-2.0

config A320_LOG_LEVEL
	int "Log Level for Touch"
	default 4

config A320
	bool "A320 Driver"
	depends on I2C && GPIO
	help
	  Projected capacitive trackpad/touchscreen controller.



config INPUT_A320_INIT_PRIORITY
  int "A320 Initialization Priority"
  default 90
```

## zmk-a320-driver/dts/bindings/avago,a320.yaml
```yaml
description: A320 Trackpad controller

compatible: "avago,a320"

include: i2c-device.yaml

properties:
  motion-gpios:
    type: phandle-array
    required: false
    description: |
      The interrupt pin of the BB Trackpad.
```
