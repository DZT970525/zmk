## app/boards/zitaotech/zitaotech_q10/board.yml
```yaml
board:
  name: zitaotech_q10
  vendor: zitaotech
  socs:
    - name: nrf52840
      variants:
        - name: zmk
```

## app/boards/zitaotech/zitaotech_q20/Kconfig.zitaotech_q20
```kconfig
# Copyright (c) 2025 ZitaoTech
# SPDX-License-Identifier: MIT

config BOARD_ZITAOTECH_Q20
    select SOC_NRF52840_QIAA
    select ZMK_BOARD_COMPAT
    imply RETAINED_MEM
    imply RETENTION
    imply RETENTION_BOOT_MODE

config ZITAOTECH_Q20_VIAL_MATRIX
    bool "Enable read-only Vial raw HID matrix tester"
    default y
    depends on BOARD_ZITAOTECH_Q20
    depends on ZMK_USB
    help
      Adds a second USB HID interface understood by Vial.  It implements the
      minimum Vial/VIA protocol needed for Vial's matrix tester; dynamic
      keymap editing is intentionally not implemented.

config ZITAOTECH_Q20_MOUSE_MAX_AGE_MS
    int "Maximum age of queued BLE pointer motion in milliseconds"
    depends on BOARD_ZITAOTECH_Q20 && ZMK_BLE && ZMK_POINTING && !ZITAOTECH_Q20_LEGACY_BLE
    default 0
    range 0 1000
    help
      When nonzero, discard stale relative X/Y motion in the BLE mouse queue.
      Button and wheel fields are retained. Zero disables the filter.

menu "A320 Trackpad Setting"

config A320_TRACKPAD_SCROLL_INTERVAL
    int "Trackpad scroll in miliseconds"
    default 50
    range 0 200
    help
      The bigger this value, the slower the trackpad scrolls

config A320_LOG_LEVEL
    int "Log Level for Touch"
    default 4

config A320
    bool "A320 Driver"
    depends on I2C && GPIO
    help
      Projected capacitive trackpad/touchscreen controller.

config INPUT_A320_INIT_PRIORITY
    int "A320 Initialization Priority"
    default 90

endmenu

menu "A320 Advanced Settings"

config A320_SCROLL_X_DIR
    int "Scroll X direction multiplier (1 for normal, -1 for inverted)"
    default 1

config A320_SCROLL_Y_DIR
    int "Scroll Y direction multiplier (1 for normal, -1 for inverted)"
    default 1

config A320_MOUSE_BASE_SPEED_PERCENT
    int "Mouse base speed (Percentage, 50 = 0.5)"
    default 150

config A320_MOUSE_SENS_BASE_PERCENT
    int "Mouse sensitivity base (Percentage, 40 = 0.3)"
    default 40

config A320_MOUSE_SENS_STEP_PERCENT
    int "Mouse sensitivity step per LED brightness (Percentage, 1 = 0.01)"
    default 1

endmenu
```

## app/boards/zitaotech/zitaotech_q20/board.yml
```yaml
board:
  name: zitaotech_q20
  vendor: zitaotech
  socs:
    - name: nrf52840
      variants:
        - name: zmk
```

## app/boards/zitaotech/zitaotech_q20/dts/bindings/zmk,behavior-trackpad-mode.yaml
```yaml
# Copyright (c) 2026 ZitaoTech
# SPDX-License-Identifier: MIT

description: Trackpad mode switch behavior

compatible: "zmk,behavior-trackpad-mode"

include: one_param.yaml
```

## app/boards/zitaotech/zitaotech_sofle/Kconfig
```kconfig
config BOARD_SOFLE_DONGLE
    bool
config BOARD_SOFLE_DONGLE_LEFT
    bool
config BOARD_SOFLE_DONGLE_RIGHT
    bool

config SOFLE_MODULAR_POINTING
    bool "SOFLE automatic per-hand pointing modules"
    select SHIELD_LEFT_BBTRACKPAD_SOFLE if BOARD_SOFLE_DONGLE_LEFT || BOARD_SOFLE_DONGLE_RIGHT
    select SHIELD_RIGHT_TRACKPOINT_SOFLE if BOARD_SOFLE_DONGLE_LEFT || BOARD_SOFLE_DONGLE_RIGHT
```

## app/boards/zitaotech/zitaotech_sofle/Kconfig.sofle_dongle
```kconfig
config BOARD_SOFLE_DONGLE
    select SOC_NRF52840_QIAA
    select ZMK_BOARD_COMPAT
    imply RETAINED_MEM
    imply RETENTION
    imply RETENTION_BOOT_MODE

config BOARD_SOFLE_DONGLE_LEFT
    select SOC_NRF52840_QIAA
    select ZMK_BOARD_COMPAT
    imply RETAINED_MEM
    imply RETENTION
    imply RETENTION_BOOT_MODE

config BOARD_SOFLE_DONGLE_RIGHT
    select SOC_NRF52840_QIAA
    select ZMK_BOARD_COMPAT
    imply RETAINED_MEM
    imply RETENTION
    imply RETENTION_BOOT_MODE
```

## app/boards/zitaotech/zitaotech_sofle/Kconfig.zitaotech_sofle_left
```kconfig
# Copyright (c) 2025 ZitaoTech
# SPDX-License-Identifier: MIT

config BOARD_ZITAOTECH_SOFLE_LEFT
    select SOC_NRF52840_QIAA
    select ZMK_BOARD_COMPAT
    imply RETAINED_MEM
    imply RETENTION
    imply RETENTION_BOOT_MODE

config BOARD_ZITAOTECH_SOFLE_RIGHT
    bool "zitaotech sofle right"
    depends on SOC_NRF52840_QIAA

menu "A320 Trackpad Setting"

config A320_TRACKPAD_SCROLL_INTERVAL
    int "Trackpad scroll in miliseconds"
    default 50
    range 0 200
    help
      The bigger this value, the slower the trackpad scrolls

config A320_LOG_LEVEL
	int "Log Level for Touch"
	default 4

config A320
	bool "A320 Driver"
	depends on I2C && GPIO
	help
	  Projected capacitive trackpad/touchscreen controller.

config INPUT_A320_INIT_PRIORITY
  int "A320 Initialization Priority"
  default 90

endmenu
```

## app/boards/zitaotech/zitaotech_sofle/board.yml
```yaml
boards:
  - name: sofle_dongle_left
    vendor: zitaotech
    socs:
      - name: nrf52840
        variants:
          - name: zmk
  - name: sofle_dongle_right
    vendor: zitaotech
    socs:
      - name: nrf52840
        variants:
          - name: zmk
```

## app/boards/zitaotech/zitaotech_sofle/dts/bindings/zmk,behavior-pointing-dpi.yaml
```yaml
# Copyright (c) 2026 ZitaoTech
# SPDX-License-Identifier: MIT

description: Independent touchpad and TrackPoint DPI adjustment behavior

compatible: "zmk,behavior-pointing-dpi"

include: two_param.yaml
```

## app/boards/zitaotech/zitaotech_sofle/dts/bindings/zmk,input-processor-trackpoint-dpi.yaml
```yaml
# Copyright (c) 2026 ZitaoTech
# SPDX-License-Identifier: MIT

description: Runtime DPI scaler for TrackPoint events received by the SOFLE central half

compatible: "zmk,input-processor-trackpoint-dpi"

include: ip_zero_param.yaml
```

## app/dts/bindings/behaviors/zitaotech,behavior-layer-mod.yaml
```yaml
description: Momentary layer with held modifier mask
compatible: "zitaotech,behavior-layer-mod"
include: two_param.yaml
```

## app/dts/bindings/behaviors/zmk,behavior-force-layer.yaml
```yaml
description: Force a target layer's bindings while held, then return to layer zero.
compatible: "zmk,behavior-force-layer"
include: one_param.yaml
```

## app/dts/bindings/behaviors/zmk,behavior-keypoint-display-mode.yaml
```yaml
# SPDX-License-Identifier: MIT
description: Cycle enabled KEYPOINT left screen display modes
compatible: "zmk,behavior-keypoint-display-mode"
include: zero_param.yaml
```

## app/dts/bindings/input_processors/zmk,input-processor-dongle-trackpad.yaml
```yaml
description: Dongle central processing of raw A320 motion
compatible: "zmk,input-processor-dongle-trackpad"
include: ip_zero_param.yaml
```

## app/src/split/Kconfig
```kconfig
# Copyright (c) 2022 The ZMK Contributors
# SPDX-License-Identifier: MIT

menuconfig ZMK_SPLIT
    bool "Split keyboard support"

if ZMK_SPLIT

config ZMK_KEYPOINT_RELAY_SOURCE
    bool "KEYPOINT left master HID relay server"
    depends on (BOARD_KEYPOINT_DONGLE_LEFT || BOARD_SOFLE_DONGLE_LEFT || BOARD_ZITAOTECH_KEYPOINT_LEFT) && ZMK_SPLIT_ROLE_CENTRAL
    select BT_EXT_ADV
    help
      Left remains master; a separate bonded identity forwards final HID reports.

config ZMK_KEYPOINT_NO_IDLE_RELAY_ADVERTISING
    bool "Diagnostic: disable unused Macintosh advertising"
    depends on ZMK_KEYPOINT_RELAY_SOURCE
    default n
    help
      Direct-host isolation test only; prevent a new Macintosh relay connection.
      Do not enable in the normal Dongle-compatible release.

config ZMK_KEYPOINT_RELAY_RECEIVER
    bool "KEYPOINT Macintosh HID receiver"
    depends on (BOARD_KEYPOINT_DONGLE || BOARD_SOFLE_DONGLE) && ZMK_SPLIT_ROLE_CENTRAL
    select BT_EXT_ADV
    select BT_GATT_CLIENT
    select BT_GATT_AUTO_DISCOVER_CCC
    help
      Receive final HID reports from the left, without split events or keymap sync.

config ZMK_KEYPOINT_RIGHT_FIXED_LEFT
    bool "KEYPOINT right always pairs to the left master"
    depends on (BOARD_KEYPOINT_DONGLE_RIGHT || BOARD_SOFLE_DONGLE_RIGHT || BOARD_ZITAOTECH_KEYPOINT_RIGHT) && ZMK_KEYPOINT_PEER_SELECTION

config ZMK_SPLIT_ROLE_CENTRAL
    bool "Split central device"

config ZMK_SPLIT_DUAL_ROLE_BUILD
    bool "Experimental KEYPOINT dual-role transport compilation"
    depends on (BOARD_KEYPOINT_DONGLE_LEFT || BOARD_SOFLE_DONGLE_LEFT || BOARD_ZITAOTECH_KEYPOINT_LEFT) && ZMK_SPLIT_BLE
    select ZMK_SPLIT_ROLE_CENTRAL
    help
      Build both transport implementations for the hybrid left half.
      This is build bring-up only; runtime routing is not yet complete.
      Keep disabled in distributed firmware.

config ZMK_SPLIT_RUNTIME_ROLE
    bool "Experimental KEYPOINT runtime role routing"
    depends on ZMK_SPLIT_DUAL_ROLE_BUILD && SETTINGS
    help
      Route keyboard and host reports according to the persisted boot role.
      The topology coordinator and configuration synchronization must be
      integrated before this can be distributed as a dual-mode release.

config ZMK_KEYPOINT_PEER_SELECTION
    bool "Experimental KEYPOINT named split peers"
    depends on ZMK_SPLIT_BLE && SETTINGS
    depends on (BOARD_KEYPOINT_DONGLE || BOARD_SOFLE_DONGLE) || (BOARD_KEYPOINT_DONGLE_LEFT || BOARD_SOFLE_DONGLE_LEFT || BOARD_ZITAOTECH_KEYPOINT_LEFT) || (BOARD_KEYPOINT_DONGLE_RIGHT || BOARD_SOFLE_DONGLE_RIGHT || BOARD_ZITAOTECH_KEYPOINT_RIGHT)
    select BT_GATT_CLIENT
    select SETTINGS_RUNTIME
    help
      Authenticate central identity over GATT and keep dongle and left-master
      addresses separately. Enable on all three devices together only after
      topology coordination and configuration synchronization are integrated.

config ZMK_KEYPOINT_CONFIG_SYNC
    bool "Experimental KEYPOINT durable configuration replay"
    depends on ZMK_SPLIT_RUNTIME_ROLE && ZMK_KEYPOINT_PEER_SELECTION
    depends on ZMK_RUNTIME_MACRO && ZMK_RUNTIME_SENSOR_ROTATE && ZMK_KEYMAP_LAYER_REORDERING
    select SETTINGS_RUNTIME
    help
      Load the authoritative configuration journal after boot settings load.
      Keep keyboard input gated until capture or committed snapshot replay
      finishes. This does not yet implement Bluetooth snapshot transport.

config ZMK_KEYPOINT_CONFIG_TRANSFER
    bool "Experimental KEYPOINT encrypted configuration export"
    depends on ZMK_KEYPOINT_CONFIG_SYNC && (BOARD_KEYPOINT_DONGLE_LEFT || BOARD_SOFLE_DONGLE_LEFT || BOARD_ZITAOTECH_KEYPOINT_LEFT)
    help
      Allow the verified dongle to read a frozen left-authority configuration
      snapshot and upload proposals over encrypted GATT. The left assigns and
      durably stores revisions, replaying proposals on its next role reboot.
      The topology coordinator and Studio proposal hooks remain pending.

config ZMK_KEYPOINT_CONFIG_DOWNLOAD
    bool "Experimental KEYPOINT dongle configuration transfer client"
    depends on ZMK_KEYPOINT_PEER_SELECTION
    depends on (BOARD_KEYPOINT_DONGLE || BOARD_SOFLE_DONGLE)
    select BT_GATT_CLIENT
    help
      Read the left's frozen authoritative configuration into a caller-owned
      staging buffer, verifying the revision, length and full CRC. The topology
      coordinator must validate and journal the result before using it. Upload
      proposals against the last acknowledged revision and wait for durable
      acceptance; the left replays them when its role reboots.

config ZMK_KEYPOINT_CONFIG_MIRROR
    bool "Experimental KEYPOINT dongle authoritative configuration bridge"
    depends on ZMK_KEYPOINT_CONFIG_DOWNLOAD && SETTINGS
    depends on ZMK_RUNTIME_MACRO && ZMK_RUNTIME_SENSOR_ROTATE && ZMK_KEYMAP_LAYER_REORDERING
    select SETTINGS_RUNTIME
    help
      Download and journal the left-authority snapshot before enabling input
      and Studio. Forward Studio changes to the left and wait for durable
      acceptance before acknowledging them. Keep disabled in released builds
      until topology coordination and hardware verification are complete.

config ZMK_KEYPOINT_TOPOLOGY_FALLBACK
    bool "Experimental KEYPOINT offline dongle fallback"
    depends on ZMK_KEYPOINT_PEER_SELECTION
    depends on (BOARD_KEYPOINT_DONGLE_LEFT || BOARD_SOFLE_DONGLE_LEFT || BOARD_ZITAOTECH_KEYPOINT_LEFT) || (BOARD_KEYPOINT_DONGLE_RIGHT || BOARD_SOFLE_DONGLE_RIGHT || BOARD_ZITAOTECH_KEYPOINT_RIGHT)
    depends on !(BOARD_KEYPOINT_DONGLE_LEFT || BOARD_SOFLE_DONGLE_LEFT || BOARD_ZITAOTECH_KEYPOINT_LEFT) || ZMK_KEYPOINT_CONFIG_SYNC
    help
      When disconnected from the dongle for the grace interval, prepare and
      checkpoint the left before rebooting it as master. The right changes
      its target to the left and refreshes its directed advertisement.
      This implements offline fallback only, not return-to-dongle discovery
      or manual topology switching. Enable only in experimental builds.

config ZMK_KEYPOINT_DONGLE_PRESENCE_SERVER
    bool "Experimental KEYPOINT dedicated dongle probe advertising"
    depends on ZMK_KEYPOINT_CONFIG_MIRROR
    select BT_EXT_ADV
    help
      Advertise a separate directed probe connection to the last authenticated
      left half without changing the host advertising set or host profiles.
      Set BT_EXT_ADV_MAX_ADV_SET to at least two. This is only the dongle endpoint;
      authenticated left-side probing is a separate integration step.

config ZMK_KEYPOINT_DONGLE_PRESENCE_CLIENT
    bool "Experimental authenticated left master dongle probe"
    depends on (BOARD_KEYPOINT_DONGLE_LEFT || BOARD_SOFLE_DONGLE_LEFT || BOARD_ZITAOTECH_KEYPOINT_LEFT) && ZMK_KEYPOINT_TOPOLOGY_FALLBACK
    help
      Scan while the right half is connected, reuse the stored dongle bond,
      and verify its encrypted identity before preparing a topology return.

config ZMK_KEYPOINT_TOPOLOGY_GRACE_MS
    int "Offline dongle fallback grace interval"
    depends on ZMK_KEYPOINT_TOPOLOGY_FALLBACK
    default 2000
    range 1000 60000

config ZMK_SPLIT_BLE
    bool "BLE Split"
    default y
    depends on ZMK_BLE
    select BT_USER_PHY_UPDATE
    select BT_AUTO_PHY_UPDATE

config ZMK_SPLIT_WIRED
    bool "Wired Split"
    default y
    depends on DT_HAS_ZMK_WIRED_SPLIT_ENABLED
    select SERIAL
    select RING_BUFFER
    select CRC

config ZMK_SPLIT_PERIPHERAL_HID_INDICATORS
    bool "Peripheral HID Indicators"
    depends on ZMK_HID_INDICATORS
    help
      Enable propagating the HID (LED) Indicator state to the split peripheral(s).

endif # ZMK_SPLIT

rsource "bluetooth/Kconfig"
rsource "wired/Kconfig"
```

## zmk-features/zmk-feature-default-layer/Kconfig
```kconfig
config ZMK_DEFAULT_LAYER
    bool "Default layer"

if ZMK_DEFAULT_LAYER

#layers between below[min, max](inclusive) can be configured as default layer
config ZMK_DEFAULT_LAYER_MIN_INDEX
    int "min layer index configurable as default layer"
    default 0

config ZMK_DEFAULT_LAYER_MAX_INDEX
    int "max layer index configurable as default layer"
    default 0

config ZMK_DEFAULT_LAYER_STUDIO_RPC
    bool "Expose the default layer in ZitaoTech Studio"
    depends on ZMK_STUDIO
    help
      Custom Studio subsystem (cormoran__default_layer) that reads and writes
      the per-endpoint and per-OS default layer mapping, including the
      "resolve through the OS mapping" endpoint value.

endif
```
