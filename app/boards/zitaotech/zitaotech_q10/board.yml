## zmk-features/zmk-feature-device-info/Kconfig
```kconfig
config ZMK_DEVICE_INFO
    bool "Enable ZMK device info reporting"

if ZMK_DEVICE_INFO

config ZMK_DEVICE_INFO_STUDIO_RPC
    bool "Enable ZMK device info custom Studio RPC"
    depends on ZMK_STUDIO

config ZMK_DEVICE_INFO_VERSION
    string "Firmware version string reported by Studio"
    depends on ZMK_DEVICE_INFO_STUDIO_RPC
    default ""
    help
      Overrides the version the module reports as build.zmk_version. Leave it
      empty to report the ZMK git describe output; set it (for example
      "BetaV0.0") to stamp an explicit release name into the firmware. Change
      this one value for every build whose version you want to name yourself.

config ZMK_DEVICE_INFO_STUDIO_RPC_REQUIRE_UNLOCK
    bool "Require a Studio unlock to read device info"
    depends on ZMK_DEVICE_INFO_STUDIO_RPC
    default y
    help
      When enabled (the default), the device info RPC subsystem is marked
      "secured": a connected Studio client must unlock the keyboard before it
      can read any device info (build/hardware/config/runtime). When disabled,
      the subsystem is "unsecured" and device info can be read without an
      unlock -- handy for headless diagnostics, but it exposes build and
      hardware details to any Studio-capable host that can reach the keyboard.

endif
```

## zmk-features/zmk-feature-matrix-tester/Kconfig
```kconfig
config ZMK_MATRIX_TESTER
    bool "Studio physical matrix tester"
    depends on ZMK_STUDIO_RPC
    depends on !ZMK_SPLIT || ZMK_SPLIT_ROLE_CENTRAL
    help
      Read-only physical key states and session test history through Studio.
```

## zmk-features/zmk-feature-runtime-tap-dance/Kconfig
```kconfig
config ZMK_RUNTIME_TAP_DANCE
    bool "Runtime tap dance"
    depends on !ZMK_SPLIT || ZMK_SPLIT_ROLE_CENTRAL
    select ZMK_BEHAVIOR_LOCAL_IDS
    select SETTINGS

if ZMK_RUNTIME_TAP_DANCE
config ZMK_RUNTIME_TAP_DANCE_COUNT
    int "Runtime tap dance slots"
    default 16
    range 1 16
config ZMK_RUNTIME_TAP_DANCE_STUDIO_RPC
    bool "Runtime tap dance Studio configuration"
    depends on ZMK_STUDIO
endif
```

## zmk-features/zmk-feature-runtime-tap-dance/dts/bindings/behaviors/zitaotech,behavior-runtime-tap-dance.yaml
```yaml
description: Runtime configurable tap dance slot
compatible: "zitaotech,behavior-runtime-tap-dance"
include: one_param.yaml
```
