## app/boards/zitaotech/hackberrypiq20/Kconfig.hackberrypiq20
```kconfig
# Copyright (c) 2026 ZitaoTech
# SPDX-License-Identifier: MIT

config BOARD_HACKBERRYPIQ20
    select SOC_RP2040
    select ZMK_BOARD_COMPAT
    imply RETAINED_MEM
    imply RETENTION
    imply RETENTION_BOOT_MODE

config HACKBERRYPIQ20_VIAL_MATRIX
    bool "Enable read-only Vial raw HID matrix tester"
    default y
    depends on BOARD_HACKBERRYPIQ20
    depends on ZMK_USB
    help
      Adds a second USB HID interface understood by Vial.  It implements the
      minimum Vial/VIA protocol needed for Vial's matrix tester; dynamic
      keymap editing is intentionally not implemented.

menu "A320 Trackpad Setting"

config A320_TRACKPAD_SCROLL_INTERVAL
    int "Trackpad scroll in miliseconds"
    default 50
    range 0 200
    help
      The bigger this value, the slower the trackpad scrolls

config A320_LOG_LEVEL
    int "Log Level for Touch"
    default 4

config A320
    bool "A320 Driver"
    depends on I2C && GPIO
    help
      Projected capacitive trackpad/touchscreen controller.

config INPUT_A320_INIT_PRIORITY
    int "A320 Initialization Priority"
    default 90

endmenu

menu "A320 Advanced Settings"

config A320_SCROLL_X_DIR
    int "Scroll X direction multiplier (1 for normal, -1 for inverted)"
    default 1

config A320_SCROLL_Y_DIR
    int "Scroll Y direction multiplier (1 for normal, -1 for inverted)"
    default 1

config A320_MOUSE_BASE_SPEED_PERCENT
    int "Mouse base speed (Percentage, 50 = 0.5)"
    default 150

config A320_MOUSE_SENS_BASE_PERCENT
    int "Mouse sensitivity base (Percentage, 40 = 0.3)"
    default 40

config A320_MOUSE_SENS_STEP_PERCENT
    int "Mouse sensitivity step per LED brightness (Percentage, 1 = 0.01)"
    default 1

endmenu
```

## app/boards/zitaotech/hackberrypiq20/board.yml
```yaml
board:
  name: hackberrypiq20
  vendor: zitaotech
  socs:
    - name: rp2040
      variants:
        - name: zmk
```

## app/boards/zitaotech/p9981/board.yml
```yaml
board:
  name: p9981
  vendor: zitaotech
  socs:
    - name: nrf52840
      variants:
        - name: zmk
```

## app/boards/zitaotech/p9981/p9981_nrf52840_zmk_defconfig
```kconfig
# P9981: original 35-key matrix, no trackpad, Q20 host BLE/Studio policy.
CONFIG_CLOCK_CONTROL_NRF_K32SRC_RC=y
CONFIG_CLOCK_CONTROL_NRF_K32SRC_500PPM=y
CONFIG_PINCTRL=y
CONFIG_GPIO=y
CONFIG_NFCT_PINS_AS_GPIOS=y
CONFIG_USE_DT_CODE_PARTITION=y
CONFIG_BUILD_OUTPUT_UF2=y
CONFIG_RETAINED_MEM=y
CONFIG_RETENTION=y
CONFIG_RETENTION_BOOT_MODE=y
CONFIG_MPU_ALLOW_FLASH_WRITE=y
CONFIG_NVS=y
CONFIG_SETTINGS_NVS=y
CONFIG_FLASH=y
CONFIG_FLASH_PAGE_LAYOUT=y
CONFIG_FLASH_MAP=y
CONFIG_NVS_LOOKUP_CACHE=y
CONFIG_NVS_LOOKUP_CACHE_SIZE=512

# Same reconnection implementation and final settings as Q20 V1.06.
CONFIG_ZMK_USB=y
CONFIG_ZMK_BLE=y
CONFIG_ZMK_KEYBOARD_NAME="p9981"
CONFIG_ZITAOTECH_BBP9981_UPSTREAM_BLE=y
CONFIG_ZITAOTECH_Q20_RECONNECT_RETRY=y
CONFIG_BT_CTLR_PHY_2M=n
CONFIG_BT_CTLR_TX_PWR_PLUS_8=y
CONFIG_BT_MAX_PAIRED=4
CONFIG_BT_MAX_CONN=4
CONFIG_BT_GATT_AUTO_SEC_REQ=n
CONFIG_BT_SMP_ALLOW_UNAUTH_OVERWRITE=y
CONFIG_ZMK_BLE_PASSKEY_ENTRY=n
CONFIG_BT_PERIPHERAL_PREF_MIN_INT=6
CONFIG_BT_PERIPHERAL_PREF_MAX_INT=12
CONFIG_BT_PERIPHERAL_PREF_LATENCY=30
CONFIG_BT_PERIPHERAL_PREF_TIMEOUT=400
CONFIG_ZMK_BLE_THREAD_PRIORITY=5
CONFIG_ZMK_BLE_THREAD_STACK_SIZE=768
CONFIG_ZMK_STUDIO_TRANSPORT_BLE_PREF_LATENCY=0

# Full factory backlight brightness; saved Studio settings retain precedence.
CONFIG_ZMK_SLEEP=y
CONFIG_ZMK_IDLE_SLEEP_TIMEOUT=0
CONFIG_ZMK_IDLE_TIMEOUT=30000
CONFIG_ZMK_BACKLIGHT=y
CONFIG_ZMK_BACKLIGHT_BRT_START=100
CONFIG_ZMK_BACKLIGHT_BRT_STEP=10
CONFIG_ZMK_BACKLIGHT_ON_START=y
CONFIG_ZMK_BACKLIGHT_AUTO_OFF_IDLE=y
CONFIG_ZMK_HID_INDICATORS=y
CONFIG_ZMK_KSCAN_DEBOUNCE_PRESS_MS=10
CONFIG_ZMK_KSCAN_DEBOUNCE_RELEASE_MS=10
CONFIG_ZMK_KSCAN_EVENT_QUEUE_SIZE=64
CONFIG_ZMK_SETTINGS_SAVE_DEBOUNCE=1000

# Mouse key behaviors remain available; no pointing sensor is instantiated.
CONFIG_ZMK_POINTING=y
CONFIG_ZMK_POINTING_SMOOTH_SCROLLING=y
CONFIG_ZMK_INPUT_PROCESSOR_TEMP_LAYER=n
CONFIG_ZITAOTECH_TRACKPAD_CONTROL=n
CONFIG_ZITAOTECH_TRACKPOINT_CONTROL=n

# Q20's Studio modules, except hardware-specific touchpad modules and Vial.
CONFIG_UART_LINE_CTRL=y
CONFIG_ZMK_STUDIO=y
CONFIG_ZMK_STUDIO_LOCKING=n
CONFIG_ZMK_STUDIO_LOCK_ON_DISCONNECT=n
CONFIG_ZMK_MATRIX_TESTER=y
CONFIG_ZMK_BEHAVIOR_LOCAL_ID_TYPE_CRC16=y
CONFIG_ZMK_RUNTIME_MACRO=y
CONFIG_ZMK_RUNTIME_MACRO_STUDIO_RPC=y
CONFIG_ZMK_RUNTIME_MACRO_COUNT=32
CONFIG_ZMK_RUNTIME_COMBO=y
CONFIG_ZMK_RUNTIME_COMBO_STUDIO_RPC=y
CONFIG_ZMK_RUNTIME_TAP_DANCE=y
CONFIG_ZMK_RUNTIME_TAP_DANCE_STUDIO_RPC=y
CONFIG_ZMK_DEVICE_INFO=y
CONFIG_ZMK_DEVICE_INFO_STUDIO_RPC=y
CONFIG_ZMK_DEFAULT_LAYER=y
CONFIG_ZMK_DEFAULT_LAYER_MAX_INDEX=3
CONFIG_ZMK_DEFAULT_LAYER_STUDIO_RPC=y
CONFIG_ZMK_OS_DETECTION=y
CONFIG_ZMK_OS_DETECTION_STUDIO_RPC=y
CONFIG_ZMK_OS_DETECTION_USB=y
CONFIG_ZMK_OS_DETECTION_BLE=n
CONFIG_ZMK_BLE_MANAGEMENT=y
CONFIG_ZMK_BLE_MANAGEMENT_STUDIO_RPC=y
CONFIG_ZMK_SETTINGS_RPC=y
CONFIG_ZMK_SETTINGS_RPC_STUDIO=y
CONFIG_ZITAOTECH_BACKLIGHT_CONTROL=y
CONFIG_ZITAOTECH_BACKLIGHT_CONTROL_STUDIO_RPC=y
CONFIG_ZITAOTECH_BOOTMAGIC=y
CONFIG_ZITAOTECH_BOOTMAGIC_STUDIO_RPC=y
CONFIG_ZITAOTECH_BOOTMAGIC_DEFAULT_KEY=32
CONFIG_ZMK_STUDIO_RPC_RX_BUF_SIZE=192
CONFIG_ZMK_STUDIO_RPC_CUSTOM_SUBSYSTEM_REQUEST_PAYLOAD_MAX_BYTES=192
CONFIG_ZMK_STUDIO_RPC_TX_BUF_SIZE=512
CONFIG_ZMK_LOW_PRIORITY_THREAD_STACK_SIZE=2048
CONFIG_ZMK_CUSTOM_SETTINGS_LARGE_VALUE_MAX_SIZE=256
CONFIG_ZMK_CUSTOM_SETTINGS_LARGE_VALUES=y
CONFIG_ZMK_CUSTOM_SETTINGS_ARRAY=y
CONFIG_MAIN_STACK_SIZE=2048
CONFIG_ZMK_USB_LOGGING=n
```

## app/boards/zitaotech/zitaotech_keypoint/Kconfig
```kconfig
# Copyright (c) 2025 ZitaoTech
# SPDX-License-Identifier: MIT

config BOARD_ZITAOTECH_KEYPOINT_LEFT
    bool

config BOARD_ZITAOTECH_KEYPOINT_RIGHT
    bool

config SOFLE_MODULAR_POINTING
    bool "KEYPOINT automatic per-hand pointing modules"
    select SHIELD_LEFT_BBTRACKPAD_KEYPOINT if BOARD_ZITAOTECH_KEYPOINT_LEFT || BOARD_ZITAOTECH_KEYPOINT_RIGHT
    select SHIELD_RIGHT_TRACKPOINT_KEYPOINT if BOARD_ZITAOTECH_KEYPOINT_LEFT || BOARD_ZITAOTECH_KEYPOINT_RIGHT


config ZITAOTECH_KEYPOINT_SCREEN
    bool
    default y if BOARD_ZITAOTECH_KEYPOINT_LEFT
    help
      Enable host telemetry and left image modes without a Dongle relay.
```

## app/boards/zitaotech/zitaotech_keypoint/board.yml
```yaml
boards:
  - name: zitaotech_keypoint_left
    vendor: zitaotech
    socs:
      - name: nrf52840
        variants:
          - name: zmk
  - name: zitaotech_keypoint_right
    vendor: zitaotech
    socs:
      - name: nrf52840
        variants:
          - name: zmk
```

## app/boards/zitaotech/zitaotech_keypoint/dts/bindings/zmk,input-processor-keypoint-trackpad.yaml
```yaml
description: Standalone KEYPOINT processing of raw A320 motion
compatible: "zmk,input-processor-keypoint-trackpad"
include: ip_zero_param.yaml
```
