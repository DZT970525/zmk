## app/boards/shields/lpm_view/Kconfig.shield
```kconfig
# Copyright (c) 2022 The ZMK Contributors
# SPDX-License-Identifier: MIT

config SHIELD_LPM_VIEW
    def_bool $(shields_list_contains,lpm_view)

config ZITAOTECH_SCREEN_STUDIO_RPC
    bool "Studio right-screen carousel configuration and USB image upload"
    depends on SHIELD_LPM_VIEW && ZMK_DISPLAY && ZMK_STUDIO_RPC
    default y
    help
      Disabling this removes the screen configuration RPC and USB image
      upload worker, while retaining normal keyboard status-screen drawing.

menuconfig LPM009M360A
		bool "LPM009M360A display driver"
		default n
		select SPI
		help 
		 Enable driver for LPM009M360A display
```

## app/boards/shields/lpm_view/dts/bindings/display/jdi,lpm009m360a.yaml
```yaml
# Copyright (c) 2023 Taisheng WANG <wstrn66@gmail.com>
# SPDX-License-Identifier: Apache-2.0

description: LPM009M360A display controller

compatible: "jdi,lpm009m360a"

include: [spi-device.yaml, display-controller.yaml]

properties:
  # extcomin_gpios:
  #   type: phandle-array
  #   description: COM Inversion Polarity Input pin.
  #
  # disp_gpios:
  #   type: phandle-array
  #   required: false
  #   description: Display ON/OFF Switching signal pin.

  color_mode:
    type: uint8-array
    default: [0x02]
    description: |
      Data mode of the panel, it is placed in the data update command:

      - 0x00: 3 bit data mode, every dot is transferred as red, green and
        blue bit, so 8 colors (black, red, green, blue, cyan, magenta, yellow,
        white) can be displayed. This mode requires the display to be driven
        with RGB565 data (LV_COLOR_DEPTH_16).
      - 0x02: 1 bit data mode, every dot is transferred as a single black or
        white bit (default).
      - 0x04: 4 bit data mode, same colors as the 3 bit data mode, but one
        dummy bit is transferred for every dot.

  rotation:
    type: int
    default: 0
    description: |
      0 for the native panel orientation (72 x 144) or 1 for the rotated
      orientation (144 x 72), width and height have to match.

  reverse:
    type: int
    default: 0
    description: |
      Invert the pixel polarity of the 1 bit data mode. It is not used in the
      color modes, use CONFIG_NICE_VIEW_WIDGET_INVERTED to invert the colors
      of the custom status screen instead.
```

## app/boards/shields/right_trackpoint_keypoint/Kconfig.defconfig
```kconfig
if SHIELD_RIGHT_TRACKPOINT_KEYPOINT

config PWM
    default y

config LED
    default y

config LED_PWM
    default y

endif # SHIELD_RIGHT_TRACKPOINT_KEYPOINT
```

## app/boards/shields/right_trackpoint_sofle/Kconfig.defconfig
```kconfig
if SHIELD_RIGHT_TRACKPOINT_SOFLE

config PWM
    default y

config LED
    default y

config LED_PWM
    default y

endif # SHIELD_RIGHT_TRACKPOINT_SOFLE
```

## app/boards/shields/st7789_display/Kconfig.shield
```kconfig
config SHIELD_ST7789_DISPLAY
    def_bool $(shields_list_contains,st7789_display)
```

## app/boards/zitaotech/Macintosch/Kconfig
```kconfig
config BOARD_SOFLE_DONGLE
    bool
config BOARD_SOFLE_DONGLE_LEFT
    bool
config BOARD_SOFLE_DONGLE_RIGHT
    bool
```

## app/boards/zitaotech/Macintosch/Kconfig.defconfig
```kconfig
if BOARD_SOFLE_DONGLE || BOARD_SOFLE_DONGLE_LEFT || BOARD_SOFLE_DONGLE_RIGHT
config ZMK_KEYBOARD_NAME
    default "Macintosch"
config ZMK_SPLIT
    default y
config ZMK_SPLIT_ROLE_CENTRAL
    default y if BOARD_SOFLE_DONGLE
    default n
config ZMK_SPLIT_PERIPHERAL_HID_INDICATORS
    default y
config BT_CTLR
    default BT
endif
```

## app/boards/zitaotech/Macintosch/board.yml
```yaml
boards:
  - name: sofle_dongle
    vendor: zitaotech
    socs:
      - name: nrf52840
        variants:
          - name: zmk
```

## app/boards/zitaotech/bb9900/board.yml
```yaml
board:
  name: bb9900
  vendor: zitaotech
  socs:
    - name: nrf52840
      variants:
        - name: zmk
```

## app/boards/zitaotech/bb9900/dts/bindings/input_processors/zmk,input-processor-sofle-left-trackpoint.yaml
```yaml
description: SOFLE left-slot TrackPoint independent scaling
compatible: "zmk,input-processor-sofle-left-trackpoint"
include: ip_zero_param.yaml
```

## app/boards/zitaotech/bbp9981/bbp9981_nrf52840_zmk_defconfig
```kconfig
# BBP9981 / nRF52840: USB + BLE, Studio and 0x3B touchpad.
# Restore the BBP9981 external LF crystal used by the legacy board.
CONFIG_PINCTRL=y
CONFIG_GPIO=y
CONFIG_USE_DT_CODE_PARTITION=y
CONFIG_BUILD_OUTPUT_UF2=y
CONFIG_RETAINED_MEM=y
CONFIG_RETENTION=y
CONFIG_RETENTION_BOOT_MODE=y
CONFIG_MPU_ALLOW_FLASH_WRITE=y
CONFIG_NVS=y
CONFIG_SETTINGS_NVS=y
CONFIG_FLASH=y
CONFIG_FLASH_PAGE_LAYOUT=y
CONFIG_FLASH_MAP=y
CONFIG_BT_CTLR_TX_PWR_PLUS_8=y
CONFIG_ZMK_SLEEP=y
CONFIG_ZMK_IDLE_SLEEP_TIMEOUT=0
CONFIG_ZMK_EXT_POWER=y
CONFIG_ZMK_IDLE_TIMEOUT=30000
CONFIG_ZMK_BACKLIGHT=y
CONFIG_ZMK_BACKLIGHT_BRT_START=80
CONFIG_ZMK_BACKLIGHT_BRT_STEP=10
CONFIG_ZMK_BACKLIGHT_ON_START=y
CONFIG_ZMK_BACKLIGHT_AUTO_OFF_IDLE=y
CONFIG_ZMK_HID_INDICATORS=y
CONFIG_INPUT=y
CONFIG_ZMK_POINTING=y
CONFIG_I2C=y
CONFIG_I2C_NRFX=y
CONFIG_A320=y
CONFIG_A320_TRACKPAD_SCROLL_INTERVAL=50
CONFIG_A320_MOUSE_BASE_SPEED_PERCENT=150
CONFIG_A320_MOUSE_SENS_BASE_PERCENT=40
CONFIG_A320_MOUSE_SENS_STEP_PERCENT=1
CONFIG_ZMK_POINTING_SMOOTH_SCROLLING=y
CONFIG_ZITAOTECH_TRACKPAD_SMOOTH_SCROLL_DEFAULT=n
CONFIG_ZMK_KSCAN_DEBOUNCE_PRESS_MS=10
CONFIG_ZMK_KSCAN_DEBOUNCE_RELEASE_MS=10
CONFIG_ZMK_USB=y
CONFIG_ZMK_BLE=y
CONFIG_BT_MAX_PAIRED=4
CONFIG_BT_MAX_CONN=4
CONFIG_ZMK_SETTINGS_SAVE_DEBOUNCE=1000
CONFIG_ZITAOTECH_BOOTMAGIC=y
CONFIG_ZITAOTECH_BOOTMAGIC_STUDIO_RPC=y
CONFIG_ZITAOTECH_BOOTMAGIC_DEFAULT_KEY=4
CONFIG_ZMK_STUDIO=y
CONFIG_ZMK_STUDIO_LOCKING=n
CONFIG_ZMK_STUDIO_LOCK_ON_DISCONNECT=n
CONFIG_ZMK_MATRIX_TESTER=y
CONFIG_ZMK_BEHAVIOR_LOCAL_ID_TYPE_CRC16=y
CONFIG_ZMK_RUNTIME_MACRO=y
CONFIG_ZMK_RUNTIME_MACRO_STUDIO_RPC=y
CONFIG_ZMK_RUNTIME_COMBO=y
CONFIG_ZMK_RUNTIME_COMBO_STUDIO_RPC=y
CONFIG_ZMK_DEVICE_INFO=y
CONFIG_ZMK_DEVICE_INFO_STUDIO_RPC=y
CONFIG_ZMK_DEFAULT_LAYER=y
CONFIG_ZMK_DEFAULT_LAYER_MAX_INDEX=4
CONFIG_ZMK_DEFAULT_LAYER_STUDIO_RPC=y
CONFIG_ZMK_OS_DETECTION=y
CONFIG_ZMK_OS_DETECTION_STUDIO_RPC=y
CONFIG_ZMK_OS_DETECTION_USB=y
CONFIG_ZMK_OS_DETECTION_BLE=n
CONFIG_ZMK_BLE_MANAGEMENT=y
CONFIG_ZMK_BLE_MANAGEMENT_STUDIO_RPC=y
CONFIG_ZMK_SETTINGS_RPC=y
CONFIG_ZMK_SETTINGS_RPC_STUDIO=y
CONFIG_ZITAOTECH_TRACKPAD_CONTROL=y
CONFIG_ZITAOTECH_TRACKPAD_CONTROL_STUDIO_RPC=y
CONFIG_ZITAOTECH_TRACKPAD_DPI_MIN=1
CONFIG_ZITAOTECH_TRACKPAD_DPI_STEP=1
CONFIG_ZITAOTECH_TRACKPAD_DRIVER_NAME="Touchpad"
CONFIG_ZMK_INPUT_PROCESSOR_TEMP_LAYER=y
CONFIG_ZITAOTECH_TRACKPAD_MOUSE_LAYER_CONTROL=y
CONFIG_ZITAOTECH_TRACKPAD_MOUSE_LAYER_DEFAULT=y
CONFIG_ZITAOTECH_TRACKPAD_MOUSE_LAYER=4
CONFIG_ZITAOTECH_TRACKPAD_ARROW_KEY_POSITION=27
CONFIG_ZITAOTECH_TRACKPAD_FAST_KEY_POSITION=37
CONFIG_ZITAOTECH_TRACKPAD_SLOW_KEY_POSITION=38
CONFIG_ZITAOTECH_TRACKPAD_TOUCH_ON_MS=1000
CONFIG_ZITAOTECH_BACKLIGHT_CONTROL=y
CONFIG_ZITAOTECH_BACKLIGHT_CONTROL_STUDIO_RPC=y
CONFIG_ZMK_STUDIO_RPC_RX_BUF_SIZE=192
CONFIG_ZMK_STUDIO_RPC_CUSTOM_SUBSYSTEM_REQUEST_PAYLOAD_MAX_BYTES=192
CONFIG_ZMK_STUDIO_RPC_TX_BUF_SIZE=512
CONFIG_ZMK_LOW_PRIORITY_THREAD_STACK_SIZE=2048
CONFIG_ZMK_CUSTOM_SETTINGS_LARGE_VALUE_MAX_SIZE=256
CONFIG_MAIN_STACK_SIZE=2048
CONFIG_BT_SMP_ALLOW_UNAUTH_OVERWRITE=y
CONFIG_ZMK_BLE_PASSKEY_ENTRY=n
CONFIG_ZMK_USB_LOGGING=n
CONFIG_ZMK_KEYBOARD_NAME="bbp9981"
CONFIG_ZITAOTECH_TRACKPAD_SCROLL_KEY_POSITION=-1
CONFIG_ZMK_RUNTIME_TAP_DANCE=y
CONFIG_ZMK_RUNTIME_TAP_DANCE_STUDIO_RPC=y
CONFIG_ZMK_RUNTIME_MACRO_COUNT=32
CONFIG_ZMK_CUSTOM_SETTINGS_LARGE_VALUES=y
CONFIG_ZMK_CUSTOM_SETTINGS_ARRAY=y





# P0.09 is a keyboard-backlight PWM output, not an NFC antenna.
CONFIG_NFCT_PINS_AS_GPIOS=y


CONFIG_ZITAOTECH_TRACKPAD_DPI_DEFAULT=30
CONFIG_ZITAOTECH_TRACKPAD_POINTER_CURVE=y
CONFIG_UART_LINE_CTRL=y
CONFIG_INPUT_THREAD_PRIORITY=9
CONFIG_INPUT_THREAD_STACK_SIZE=2048
CONFIG_ZMK_BLE_THREAD_PRIORITY=5
CONFIG_BT_PERIPHERAL_PREF_MIN_INT=6
CONFIG_BT_PERIPHERAL_PREF_MAX_INT=12
CONFIG_BT_PERIPHERAL_PREF_LATENCY=30
CONFIG_BT_PERIPHERAL_PREF_TIMEOUT=400
CONFIG_ZMK_STUDIO_TRANSPORT_BLE_PREF_LATENCY=0
# Let the central restore encryption; application requests security after a grace period.
CONFIG_BT_GATT_AUTO_SEC_REQ=n
CONFIG_NVS_LOOKUP_CACHE=y
CONFIG_NVS_LOOKUP_CACHE_SIZE=512
CONFIG_I2C_NRFX_TRANSFER_TIMEOUT=100

# Use pinned upstream BLE/HOG and same-peer Just Works re-pairing.
CONFIG_ZITAOTECH_BBP9981_UPSTREAM_BLE=y
CONFIG_ZMK_BLE_THREAD_STACK_SIZE=768
```

## app/boards/zitaotech/bbq20/Kconfig.bbq20
```kconfig
# Copyright (c) 2025 ZitaoTech
# SPDX-License-Identifier: MIT

config BOARD_BBQ20
    select SOC_NRF52840_QIAA
    select ZMK_BOARD_COMPAT
    imply RETAINED_MEM
    imply RETENTION
    imply RETENTION_BOOT_MODE

menu "A320 Trackpad Setting"

config A320_TRACKPAD_SCROLL_INTERVAL
    int "Trackpad scroll in miliseconds"
    default 50
    range 0 200
    help
      The bigger this value, the slower the trackpad scrolls

config A320_LOG_LEVEL
    int "Log Level for Touch"
    default 4

config A320
    bool "A320 Driver"
    depends on I2C && GPIO
    help
      Projected capacitive trackpad/touchscreen controller.

config INPUT_A320_INIT_PRIORITY
    int "A320 Initialization Priority"
    default 90

endmenu

menu "A320 Advanced Settings"

config A320_SCROLL_X_DIR
    int "Scroll X direction multiplier (1 for normal, -1 for inverted)"
    default 1

config A320_SCROLL_Y_DIR
    int "Scroll Y direction multiplier (1 for normal, -1 for inverted)"
    default 1

config A320_MOUSE_BASE_SPEED_PERCENT
    int "Mouse base speed (Percentage, 50 = 0.5)"
    default 150

config A320_MOUSE_SENS_BASE_PERCENT
    int "Mouse sensitivity base (Percentage, 40 = 0.3)"
    default 40

config A320_MOUSE_SENS_STEP_PERCENT
    int "Mouse sensitivity step per LED brightness (Percentage, 1 = 0.01)"
    default 1

endmenu
```

## app/boards/zitaotech/bbq20/bbq20_nrf52840_zmk_defconfig
```kconfig
# BBQ20 / nRF52840: USB + BLE, Studio and 0x3B touchpad.
CONFIG_CLOCK_CONTROL_NRF_K32SRC_RC=y
CONFIG_PINCTRL=y
CONFIG_GPIO=y
CONFIG_USE_DT_CODE_PARTITION=y
CONFIG_BUILD_OUTPUT_UF2=y
CONFIG_RETAINED_MEM=y
CONFIG_RETENTION=y
CONFIG_RETENTION_BOOT_MODE=y
CONFIG_MPU_ALLOW_FLASH_WRITE=y
CONFIG_NVS=y
CONFIG_SETTINGS_NVS=y
CONFIG_FLASH=y
CONFIG_FLASH_PAGE_LAYOUT=y
CONFIG_FLASH_MAP=y
CONFIG_BT_CTLR_TX_PWR_PLUS_8=y
CONFIG_ZMK_SLEEP=n
CONFIG_ZMK_EXT_POWER=y
CONFIG_ZMK_IDLE_TIMEOUT=30000
CONFIG_ZMK_BACKLIGHT=y
CONFIG_ZMK_BACKLIGHT_BRT_START=40
CONFIG_ZMK_BACKLIGHT_BRT_STEP=10
CONFIG_ZMK_BACKLIGHT_ON_START=y
CONFIG_ZMK_BACKLIGHT_AUTO_OFF_IDLE=y
CONFIG_ZMK_HID_INDICATORS=y
CONFIG_INPUT=y
CONFIG_ZMK_POINTING=y
CONFIG_I2C=y
CONFIG_I2C_NRFX=y
CONFIG_A320=y
CONFIG_A320_TRACKPAD_SCROLL_INTERVAL=50
CONFIG_A320_MOUSE_BASE_SPEED_PERCENT=150
CONFIG_A320_MOUSE_SENS_BASE_PERCENT=40
CONFIG_A320_MOUSE_SENS_STEP_PERCENT=1
CONFIG_ZMK_POINTING_SMOOTH_SCROLLING=y
CONFIG_ZMK_KSCAN_DEBOUNCE_PRESS_MS=10
CONFIG_ZMK_KSCAN_DEBOUNCE_RELEASE_MS=10
CONFIG_ZMK_KSCAN_MATRIX_WAIT_BEFORE_INPUTS=5
CONFIG_ZMK_KSCAN_MATRIX_WAIT_BETWEEN_OUTPUTS=20
CONFIG_ZMK_USB=y
CONFIG_ZMK_BLE=y
CONFIG_BT_MAX_PAIRED=4
CONFIG_BT_MAX_CONN=4
CONFIG_ZMK_SETTINGS_SAVE_DEBOUNCE=1000
CONFIG_ZITAOTECH_BOOTMAGIC=y
CONFIG_ZITAOTECH_BOOTMAGIC_STUDIO_RPC=y
CONFIG_ZITAOTECH_BOOTMAGIC_DEFAULT_KEY=2
CONFIG_ZMK_STUDIO=y
CONFIG_ZMK_STUDIO_LOCKING=n
CONFIG_ZMK_STUDIO_LOCK_ON_DISCONNECT=n
CONFIG_ZMK_MATRIX_TESTER=y
CONFIG_ZMK_BEHAVIOR_LOCAL_ID_TYPE_CRC16=y
CONFIG_ZMK_RUNTIME_MACRO=y
CONFIG_ZMK_RUNTIME_MACRO_STUDIO_RPC=y
CONFIG_ZMK_RUNTIME_COMBO=y
CONFIG_ZMK_RUNTIME_COMBO_STUDIO_RPC=y
CONFIG_ZMK_DEVICE_INFO=y
CONFIG_ZMK_DEVICE_INFO_STUDIO_RPC=y
CONFIG_ZMK_DEFAULT_LAYER=y
CONFIG_ZMK_DEFAULT_LAYER_MAX_INDEX=4
CONFIG_ZMK_DEFAULT_LAYER_STUDIO_RPC=y
CONFIG_ZMK_OS_DETECTION=y
CONFIG_ZMK_OS_DETECTION_STUDIO_RPC=y
CONFIG_ZMK_OS_DETECTION_USB=y
CONFIG_ZMK_OS_DETECTION_BLE=y
CONFIG_ZMK_BLE_MANAGEMENT=y
CONFIG_ZMK_BLE_MANAGEMENT_STUDIO_RPC=y
CONFIG_ZMK_SETTINGS_RPC=y
CONFIG_ZMK_SETTINGS_RPC_STUDIO=y
CONFIG_ZITAOTECH_TRACKPAD_CONTROL=y
CONFIG_ZITAOTECH_TRACKPAD_CONTROL_STUDIO_RPC=y
CONFIG_ZITAOTECH_TRACKPAD_DPI_MIN=1
CONFIG_ZITAOTECH_TRACKPAD_DPI_STEP=1
CONFIG_ZITAOTECH_TRACKPAD_DRIVER_NAME="Touchpad"
CONFIG_ZMK_INPUT_PROCESSOR_TEMP_LAYER=y
CONFIG_ZITAOTECH_TRACKPAD_MOUSE_LAYER_CONTROL=y
CONFIG_ZITAOTECH_TRACKPAD_MOUSE_LAYER_DEFAULT=n
CONFIG_ZITAOTECH_TRACKPAD_MOUSE_LAYER=4
CONFIG_ZITAOTECH_TRACKPAD_ARROW_KEY_POSITION=27
CONFIG_ZITAOTECH_TRACKPAD_FAST_KEY_POSITION=37
CONFIG_ZITAOTECH_TRACKPAD_SLOW_KEY_POSITION=38
CONFIG_ZITAOTECH_TRACKPAD_TOUCH_ON_MS=800
CONFIG_ZITAOTECH_BACKLIGHT_CONTROL=y
CONFIG_ZITAOTECH_BACKLIGHT_CONTROL_STUDIO_RPC=y
CONFIG_ZMK_STUDIO_RPC_RX_BUF_SIZE=192
CONFIG_ZMK_STUDIO_RPC_CUSTOM_SUBSYSTEM_REQUEST_PAYLOAD_MAX_BYTES=192
CONFIG_ZMK_STUDIO_RPC_TX_BUF_SIZE=512
CONFIG_ZMK_LOW_PRIORITY_THREAD_STACK_SIZE=2048
CONFIG_ZMK_CUSTOM_SETTINGS_LARGE_VALUE_MAX_SIZE=256
CONFIG_MAIN_STACK_SIZE=2048
CONFIG_BT_SMP_ALLOW_UNAUTH_OVERWRITE=y
CONFIG_ZMK_BLE_PASSKEY_ENTRY=n
CONFIG_ZMK_USB_LOGGING=n
CONFIG_ZMK_KEYBOARD_NAME="BBQ20"
CONFIG_ZMK_DEVICE_INFO_VERSION="BBQ20-V0.4"
CONFIG_ZITAOTECH_TRACKPAD_SCROLL_KEY_POSITION=2
CONFIG_ZMK_RUNTIME_TAP_DANCE=y
CONFIG_ZMK_RUNTIME_TAP_DANCE_STUDIO_RPC=y
CONFIG_ZMK_RUNTIME_MACRO_COUNT=32
CONFIG_ZMK_CUSTOM_SETTINGS_LARGE_VALUES=y
CONFIG_ZMK_CUSTOM_SETTINGS_ARRAY=y
```

## app/boards/zitaotech/bbq20/board.yml
```yaml
board:
  name: bbq20
  vendor: zitaotech
  socs:
    - name: nrf52840
      variants:
        - name: zmk
```

## app/boards/zitaotech/bbq20/dts/bindings/input_processors/zmk,input-processor-sofle-right-trackpad.yaml
```yaml
description: SOFLE right-slot trackpad independent scaling
compatible: "zmk,input-processor-sofle-right-trackpad"
include: ip_zero_param.yaml
```

## app/boards/zitaotech/hackberrypiq20/Kconfig.defconfig
```kconfig
#
# Copyright (c) 2026 ZitaoTech
# SPDX-License-Identifier: MIT
#

if BOARD_HACKBERRYPIQ20

config ZMK_KEYBOARD_NAME
    default "HackberryPiQ20"

config RP2_FLASH_W25Q080
    default y

if ZMK_BACKLIGHT

config PWM
    default y

config LED
    default y

config LED_PWM
    default y

endif # ZMK_BACKLIGHT

# ---------------------------------------------------------------------------
# ZitaoTech Studio tabs: the same feature set the Q10/Q20 boards use -
# runtime trackpad (DPI / scroll / mouse layer) and backlight effects.
# ---------------------------------------------------------------------------
config ZITAOTECH_TRACKPAD_CONTROL
    default y

config ZITAOTECH_TRACKPAD_CONTROL_STUDIO_RPC
    default y

config ZMK_INPUT_PROCESSOR_TEMP_LAYER
    default y

config ZITAOTECH_TRACKPAD_MOUSE_LAYER_CONTROL
    default y

config ZITAOTECH_BACKLIGHT_CONTROL
    default y

config ZITAOTECH_BACKLIGHT_CONTROL_STUDIO_RPC
    default y

endif # BOARD_HACKBERRYPIQ20
```
