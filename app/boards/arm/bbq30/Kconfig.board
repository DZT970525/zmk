## app/boards/arm/bbq30/Kconfig.board
```kconfig
# Copyright (c) 2023 ZitaoTech
# SPDX-License-Identifier: MIT

config BOARD_BBQ30
    bool "bbq30"
    depends on SOC_NRF52840_QIAA
```

## app/boards/arm/keypoint_dongle/Kconfig
```kconfig
# Copyright (c) 2025 ZitaoTech
# SPDX-License-Identifier: MIT

config BOARD_KEYPOINT_DONGLE
    bool

config BOARD_KEYPOINT_DONGLE_LEFT
    bool

config BOARD_KEYPOINT_DONGLE_RIGHT
    bool
```

## app/boards/arm/keypoint_dongle/Kconfig.defconfig
```kconfig
#
# Copyright (c) 2025 ZitaoTech
# SPDX-License-Identifier: MIT
#

if BOARD_KEYPOINT_DONGLE

config ZMK_KEYBOARD_NAME
    default "KEYPOINT_DONGLE"

config ZMK_SPLIT_ROLE_CENTRAL
    default y

endif # BOARD_SOFLE_DONGLE


if BOARD_KEYPOINT_DONGLE || BOARD_KEYPOINT_DONGLE_LEFT || BOARD_KEYPOINT_DONGLE_RIGHT

if ZMK_BACKLIGHT

config PWM
    default y

config LED_PWM
    default y

endif # ZMK_BACKLIGHT

config BOARD
    default "KEYPOINT_DONGLE"

config ZMK_SPLIT
    default y

config ZMK_SPLIT_PERIPHERAL_HID_INDICATORS
    default y

config BT_CTLR
    default BT

endif # BOARD_KEYPOINT_DONGLE || BOARD_KEYPOINT_DONGLE_LEFT || BOARD_KEYPOINT_DONGLE_RIGHT
```

## app/boards/arm/zitaotech_q10/Kconfig.defconfig
```kconfig
# Copyright (c) 2025 ZitaoTech
# SPDX-License-Identifier: MIT

if BOARD_ZITAOTECH_Q10


config ZMK_KEYBOARD_NAME
    default "ZitaoTech_q10"

if USB_DEVICE_STACK

config USB_NRFX
    default y

endif # USB_DEVICE_STACK

if ZMK_BACKLIGHT

config PWM
    default y

config LED_PWM
    default y

endif # ZMK_BACKLIGHT

config BT_CTLR
    default BT

endif # BOARD_ZITAOTECH_Q10
```

## app/boards/shields/bb9900/Kconfig.board
```kconfig
# Copyright (c) 2023 ZitaoTech
# SPDX-License-Identifier: MIT

config BOARD_BB9900
    bool "bb9900"
    depends on SOC_NRF52840_QIAA

menu "Backlight and LED options"

config TRACKPAD_LED_BRIGHTNESS
    int "Trackpad LED brightness when CapsLock is on"
    default 90
    range 0 100
    help
      The brightness value (0-100) to set the Trackpad LED when Caps Lock is active.

endmenu
```

## app/boards/zitao48/Kconfig
```kconfig
# Copyright (c) 2023 ZitaoTech
# SPDX-License-Identifier: MIT

config BOARD_ZITAO48_LEFT
    bool

config BOARD_ZITAO48_RIGHT
    bool
```

## app/boards/zitao48/Kconfig.board
```kconfig
# Copyright (c) 2023 ZitaoTech
# SPDX-License-Identifier: MIT

config BOARD_ZITAO48_LEFT
    bool "zitao48 left"
    depends on SOC_NRF52840_QIAA

config BOARD_ZITAO48_RIGHT
    bool "zitao48 right"
    depends on SOC_NRF52840_QIAA
```

## app/module/drivers/sensor/a320/Kconfig
```kconfig
menuconfig INPUT_A320
    bool "A320 touchpad Driver"
    depends on I2C
    help
      Enable driver for A320
```
