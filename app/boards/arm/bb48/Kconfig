## app/boards/arm/bb48/Kconfig
```kconfig
# Copyright (c) 2025 ZitaoTech
# SPDX-License-Identifier: MIT

config BOARD_BB48_LEFT
    bool

config BOARD_BB48_RIGHT
    bool
```

## app/boards/arm/bb48/Kconfig.board
```kconfig
# Copyright (c) 2023 ZitaoTech
# SPDX-License-Identifier: MIT

config BOARD_BB48_LEFT
    bool "BB48 left"
    depends on SOC_NRF52840_QIAA

config BOARD_BB48_RIGHT
    bool "BB48 right"
    depends on SOC_NRF52840_QIAA


menu "A320 Trackpad Setting"

config A320_TRACKPAD_SCROLL_INTERVAL
    int "Trackpad scroll in miliseconds"
    default 50
    range 0 200
    help
      The bigger this value, the slower the trackpad scrolls

config A320_LOG_LEVEL
	int "Log Level for Touch"
	default 4

config A320
	bool "A320 Driver"
	depends on I2C && GPIO
	help
	  Projected capacitive trackpad/touchscreen controller.

config INPUT_A320_INIT_PRIORITY
  int "A320 Initialization Priority"
  default 90

endmenu
```

## app/boards/arm/bb48/Kconfig.defconfig
```kconfig
#
# Copyright (c) 2025 ZitaoTech
# SPDX-License-Identifier: MIT
#

if BOARD_BB48_LEFT

config ZMK_KEYBOARD_NAME
    default "BB48"

config ZMK_SPLIT_ROLE_CENTRAL
    default y

endif # BOARD_BB48_LEFT


if BOARD_BB48_LEFT || BOARD_BB48_RIGHT

if ZMK_BACKLIGHT

config PWM
    default y

config LED_PWM
    default y

endif # ZMK_BACKLIGHT

config BOARD
    default "BB48"

config ZMK_SPLIT
    default y

config ZMK_SPLIT_PERIPHERAL_HID_INDICATORS
    default y

config BT_CTLR
    default BT
endif # BOARD_BB48_LEFT || BOARD_BB48_RIGHT
```

## app/boards/arm/bbkeyboard_dongle/Kconfig.board
```kconfig
# Copyright (c) 2023 ZitaoTech
# SPDX-License-Identifier: MIT

config BOARD_MACINTOSCH_DONGLE
    bool "macintosch_dongle"
    depends on SOC_NRF52840_QIAA

config BOARD_BBKEYBOARD
    bool "bbkeyboard"
    depends on SOC_NRF52840_QIAA
```

## app/boards/arm/bbkeyboard_dongle/Kconfig.defconfig
```kconfig
# Copyright (c) 2025 ZitaoTech
# SPDX-License-Identifier: MIT

if BOARD_MACINTOSCH_DONGLE

config ZMK_KEYBOARD_NAME
    default "BBKEYBOARD_DONGLE"

config ZMK_SPLIT_ROLE_CENTRAL
    default y

endif # BOARD_MACINTOSCH_DONGLE

if BOARD_MACINTOSCH_DONGLE || BOARD_BBKEYBOARD

if ZMK_BACKLIGHT

config PWM
    default y

config LED_PWM
    default y

endif # ZMK_BACKLIGHT

config BOARD
    default "BBKEYBOARD_DONGLE"

config ZMK_SPLIT
    default y

config ZMK_SPLIT_PERIPHERAL_HID_INDICATORS
    default y

config BT_CTLR
    default BT
endif # BOARD_MACINTOSCH_DONGLE || BOARD_BBKEYBOARD
```

## app/boards/arm/bbp9981/dts/bindings/zmk,behavior-trackpad-dpi.yaml
```yaml
# Copyright (c) 2026 ZitaoTech
# SPDX-License-Identifier: MIT

description: Trackpad DPI adjustment behavior

compatible: "zmk,behavior-trackpad-dpi"

include: one_param.yaml
```

## app/boards/arm/bbp9983/Kconfig.board
```kconfig
# Copyright (c) 2023 ZitaoTech
# SPDX-License-Identifier: MIT

config BOARD_BBP9983
    bool "bbp9983"
    depends on SOC_NRF52840_QIAA

menu "Backlight and LED options"

config TRACKPAD_LED_BRIGHTNESS
    int "Trackpad LED brightness when CapsLock is on"
    default 90
    range 0 100
    help
      The brightness value (0-100) to set the Trackpad LED when Caps Lock is active.

endmenu

menu "A320 Trackpad Setting"

config A320_TRACKPAD_SCROLL_INTERVAL
    int "Trackpad scroll in miliseconds"
    default 50
    range 0 200
    help
      The bigger this value, the slower the trackpad scrolls

config A320_TRACKPAD_SPEEDMULTIPLIER_VERTICAL
    int "Trackpad speed multiplier y"
    default 100
    range 1 100
    help
      from 1 to 100

config A320_TRACKPAD_SPEEDMULTIPLIER_HORIZONTAL
    int "Trackpad speed multiplier x"
    default 100
    range 1 100
    help
      from 1 to 100

endmenu
```

## app/boards/arm/central/Kconfig.board
```kconfig
# Copyright (c) 2023 ZitaoTech
# SPDX-License-Identifier: MIT

config BOARD_CENTRALDONGLE
    bool "centraldongle"
    depends on SOC_NRF52840_QIAA

config BOARD_P9981_PHERIPHERAL
    bool "P9981_PERIPHERAL"
    depends on SOC_NRF52840_QIAA
```

## app/boards/arm/central/Kconfig.defconfig
```kconfig
# Copyright (c) 2025 ZitaoTech
# SPDX-License-Identifier: MIT

if BOARD_CENTRALDONGLE

config ZMK_KEYBOARD_NAME
    default "CENTRAL"

config ZMK_SPLIT_ROLE_CENTRAL
    default y

endif # BOARD_CENTRALDONGLE

if BOARD_CENTRALDONGLE || BOARD_P9981_PHERIPHERAL

if ZMK_BACKLIGHT

config PWM
    default y

config LED_PWM
    default y

endif # ZMK_BACKLIGHT

config BOARD
    default "CENTRAL"

config ZMK_SPLIT
    default y

config ZMK_SPLIT_PERIPHERAL_HID_INDICATORS
    default y

config BT_CTLR
    default BT
endif # BOARD_CENTRALDONGLE || BOARD_P9981_PERIPHERAL
```

## app/boards/arm/zitaotech_planck46/Kconfig
```kconfig
# Copyright (c) 2025 ZitaoTech
# SPDX-License-Identifier: MIT

config BOARD_ZITAOTECH_PLANCK46_LEFT
    bool

config BOARD_ZITAOTECH_PLANCK46_RIGHT
    bool
```

## app/boards/arm/zitaotech_planck46/Kconfig.board
```kconfig
# Copyright (c) 2023 ZitaoTech
# SPDX-License-Identifier: MIT

config BOARD_ZITAOTECH_PLANCK46_LEFT
    bool "ZITAOTECH_PLANCK46 left"
    depends on SOC_NRF52840_QIAA

config BOARD_ZITAOTECH_PLANCK46_RIGHT
    bool "ZITAOTECH_PLANCK46 right"
    depends on SOC_NRF52840_QIAA


menu "A320 Trackpad Setting"

config A320_TRACKPAD_SCROLL_INTERVAL
    int "Trackpad scroll in miliseconds"
    default 50
    range 0 200
    help
      The bigger this value, the slower the trackpad scrolls

config A320_LOG_LEVEL
	int "Log Level for Touch"
	default 4

config A320
	bool "A320 Driver"
	depends on I2C && GPIO
	help
	  Projected capacitive trackpad/touchscreen controller.

config INPUT_A320_INIT_PRIORITY
  int "A320 Initialization Priority"
  default 90

endmenu
```

## app/boards/arm/zitaotech_q20/Kconfig.defconfig
```kconfig
# Copyright (c) 2025 ZitaoTech
# SPDX-License-Identifier: MIT

if BOARD_ZITAOTECH_Q20


config ZMK_KEYBOARD_NAME
    default "ZitaoTech_q20"

if USB_DEVICE_STACK

config USB_NRFX
    default y

endif # USB_DEVICE_STACK

if ZMK_BACKLIGHT

config PWM
    default y

config LED_PWM
    default y

endif # ZMK_BACKLIGHT

config BT_CTLR
    default BT

endif # BOARD_ZITAOTECH_Q20
```

## app/boards/arm/zitaotech_sofle_z/Kconfig
```kconfig
# Copyright (c) 2025 ZitaoTech
# SPDX-License-Identifier: MIT

config BOARD_ZITAOTECH_SOFLE_Z_LEFT
    bool

config BOARD_ZITAOTECH_SOFLE_Z_RIGHT
    bool
```

## app/boards/arm/zitaotech_sofle_z/Kconfig.defconfig
```kconfig
#
# Copyright (c) 2025 ZitaoTech
# SPDX-License-Identifier: MIT
#

if BOARD_ZITAOTECH_SOFLE_Z_RIGHT

config ZMK_KEYBOARD_NAME
    default "ZITAOTECH_SOFLE_Z"

config ZMK_SPLIT_ROLE_CENTRAL
    default y

endif # BOARD_ZITAOTECH_SOFLE_Z_RIGHT


if BOARD_ZITAOTECH_SOFLE_Z_LEFT || BOARD_ZITAOTECH_SOFLE_Z_RIGHT

if ZMK_BACKLIGHT

config PWM
    default y

config LED_PWM
    default y

endif # ZMK_BACKLIGHT

config BOARD
    default "ZITAOTECH_SOFLE_Z"

config ZMK_SPLIT
    default y

config ZMK_SPLIT_PERIPHERAL_HID_INDICATORS
    default y

config BT_CTLR
    default BT

endif # BOARD_ZITAOTECH_SOFLE_Z_LEFT || BOARD_ZITAOTECH_SOFLE_Z_RIGHT
```

## app/boards/bbp9981.conf
```kconfig
# CONFIG_ZMK_INDICATOR_TP=y
# CONFIG_ZMK_KEYBOARD_BACKLIGHT_BRIGHTNESS=90
# CONFIG_ZMK_KEYBOARD_MIDDLEBACKLIGHT=y

# CONFIG_A320=y
# CONFIG_INPUT=y
# CONFIG_ZMK_MOUSE=y
# CONFIG_ZMK_POINTING=y
```

## app/boards/shields/ls_view/Kconfig.shield
```kconfig
# Copyright (c) 2022 The ZMK Contributors
# SPDX-License-Identifier: MIT

config SHIELD_LS_VIEW
    def_bool $(shields_list_contains,ls_view)

menuconfig LS013B7DH06
		bool "LS013B7DH06 display driver"
		default n
		select SPI
		help 
		 Enable driver for LS013B7DH06 display
```

## app/boards/shields/right_bbtrackball/Kconfig.shield
```kconfig
# Copyright (c) 2022 The ZMK Contributors
# SPDX-License-Identifier: MIT

config SHIELD_RIGHT_BBTRACKBALL
    def_bool $(shields_list_contains,right_bbtrackball)
```

## app/boards/shields/right_bbtrackball_corne/Kconfig.shield
```kconfig
# Copyright (c) 2022 The ZMK Contributors
# SPDX-License-Identifier: MIT

config SHIELD_RIGHT_BBTRACKBALL_CORNE
    def_bool $(shields_list_contains,right_bbtrackball_corne)
```

## app/boards/zitao48/Kconfig.defconfig
```kconfig
#
# Copyright (c) 2022 Darryl deHaan
# SPDX-License-Identifier: MIT
#

if BOARD_ZITAO48_LEFT

config ZMK_KEYBOARD_NAME
    default "zitao48"

config ZMK_SPLIT_ROLE_CENTRAL
    default y

endif # BOARD_ZITAO48_LEFT


if BOARD_ZITAO48_LEFT || BOARD_ZITAO48_RIGHT

if ZMK_BACKLIGHT

config PWM
    default y

config LED_PWM
    default y

endif # ZMK_BACKLIGHT

config BOARD
    default "zitao48"

config ZMK_SPLIT
    default y

config BT_CTLR
    default BT
endif # BOARD_ZITAO48_LEFT || BOARD_ZITAO48_RIGHT
```
